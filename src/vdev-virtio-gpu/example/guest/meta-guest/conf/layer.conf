## src/vdev-virtio-gpu/example/guest/meta-guest/conf/layer.conf
```bitbake
BBPATH .= ":${LAYERDIR}"

BBFILES += "${LAYERDIR}/recipes-*/*/*.bb \
            ${LAYERDIR}/recipes-*/*/*.bbappend"

BBFILE_COLLECTIONS += "meta-guest"
BBFILE_PATTERN_meta-guest = "^${LAYERDIR}/"
BBFILE_PRIORITY_meta-guest = "6"

LAYERDEPENDS_meta-guest = "core"
LAYERSERIES_COMPAT_meta-guest = "scarthgap"
```
